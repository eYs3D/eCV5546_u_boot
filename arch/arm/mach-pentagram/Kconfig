## arch/arm/mach-pentagram/Kconfig
```kconfig
if ARCH_PENTAGRAM

choice
	prompt "Board select"

config TARGET_PENTAGRAM_eCV5546
	bool "eCV5546 Board (eCV5546 C-chip)"
	select ARM64
	select ENABLE_ARM_SOC_BOOT0_HOOK

endchoice

choice
	prompt "Verification Environment"

config SYS_ENV_ZEBU
	bool "zebu environment"

config SYS_ENV_eCV5546_EVB
	bool "eCV5546 EVB"

endchoice

config SYS_ZMEM_SKIP_RELOC
	bool "zmem skip reloc"
	default y
	depends on SYS_ENV_ZEBU && !SD_BOOT && !NAND_BOOT

config SP_ZMEM_RELOC_ADDR
	hex "zmem reloc address"
	default 0x1F00000
	depends on SYS_ZMEM_SKIP_RELOC
	help
	  Fixed reloc address of u-boot on zmem environemnt.
	  This address is chosen by zmem firmware so follow
	  the zmem layout to assign this value. Zmem will
	  put the image with header on this address so the
	  first word of this address will be first 4 bytes
	  of header not the ENTRY() of text code.

config SP_TIMER
	bool "eYs3D timer"
	default y
	help
	  Support eYs3D STC timer

source "board/eys3d/ecv5546/Kconfig"

endif
```

## board/eys3d/ecv5546/Kconfig
```kconfig
if TARGET_PENTAGRAM_eCV5546

config SYS_CONFIG_NAME
	default "pentagram_common_ecv5546"

config SYS_SOC
	default "pentagram"

config SYS_BOARD
	default "ecv5546"

config SYS_VENDOR
	default "eys3d"

config SYS_USE_QKBOOT_HEADER
	bool "use Sunpls quick boot header"
	default n
	help
	  Enable eYs3D quick boot header
	  eYs3D quick boot header is the same
	  as mkimage header. It also has 64 bytes
	  size with the same fields. We only change
	  crc and type in generic mkimage header.
	  It can speed up boot time. If enabled, we
	  replace mkimage header of kernel image and
	  also add eys3d-mkimage header on dtb image.

config SRCADDR_KERNEL
	hex "Linux kernel source address"
	default 0x0 if SD_BOOT
	default 0x0 if NAND_BOOT
	default 0xF0200000
	help
	  Linux kernel source address
	  Linux kernel image is stored in this
	  address. This address can be nand/emmc
	  address.

config SRCADDR_KERNEL_BKUP
	hex "The backup of linux kernel source address"
	default 0x0 if SD_BOOT
	default 0x0 if NAND_BOOT
	default 0x12222
	help
	  The backup of linux kernel source address
	  Linux kernel backup of image is stored in this
	  address. This address can be nand/emmc
	  address.

config SRCADDR_DTB
	hex "DTB source address"
	default 0x0 if SD_BOOT
	default 0x0 if NAND_BOOT
	default 0xF0040000
	help
	  DTB(device tree blob) source address
	  DTB image is stored in this address.
	  This address can be nand/emmc address.

config HUSH_PARSER
	default y

config SP_UTIL_MON
	bool "enable eYs3D mon util"
	default y
	help
	  Enable eYs3D mon util
	  It is useful to read/write eYs3D register
	  group.

config SP_JTAG
	bool "enable JTAG"
	help
	  Setup JTAG setting
	  For Cortex-M4, setup JTAG config and pinmux.

endif
```

## configs/ecv5546_emmc_ic1_defconfig
```kconfig
CONFIG_ARM=y
CONFIG_ARCH_PENTAGRAM=y
CONFIG_TARGET_PENTAGRAM_eCV5546=y
CONFIG_SYS_ENV_eCV5546_EVB=y
CONFIG_SRCADDR_KERNEL=0x2222
CONFIG_SRCADDR_DTB=0x2022
CONFIG_SRCADDR_NONOS=0x1822
CONFIG_TEXT_BASE=0x500000
CONFIG_SYS_MALLOC_F_LEN=0x40000
CONFIG_SYS_LOAD_ADDR=0x2000000
CONFIG_SYS_MALLOC_LEN=0x1000000
CONFIG_SYS_BOOTM_LEN=0x4000000
# CONFIG_USE_ARCH_MEMCPY is not set
# CONFIG_USE_ARCH_MEMSET is not set
# CONFIG_DEBUG_UART is not set
CONFIG_PHYS_64BIT=y
CONFIG_BOOTDELAY=0
CONFIG_REGEX=y
CONFIG_CMD_BOOTZ=y
CONFIG_CMD_MD5SUM=y
CONFIG_MD5SUM_VERIFY=y
CONFIG_CMD_MEMINFO=y
CONFIG_CMD_GPT=y
CONFIG_CMD_GPT_RENAME=y
CONFIG_CMD_MMC=y
CONFIG_CMD_PART=y
CONFIG_CMD_USB=y
CONFIG_CMD_UUID=y
CONFIG_CMD_EXT2=y
CONFIG_CMD_FAT=y
CONFIG_CMD_EXT4=y
CONFIG_CMD_FS_GENERIC=y

CONFIG_OF_SEPARATE=y

CONFIG_CLK_CCF=y
CONFIG_CLK_COMPOSITE_CCF=y

CONFIG_ENV_IS_IN_MMC=y
CONFIG_ENV_OFFSET=0x304400
CONFIG_ENV_SIZE=0x20000
CONFIG_SYS_REDUNDAND_ENVIRONMENT=y
CONFIG_ENV_OFFSET_REDUND=0x384400
CONFIG_MMC=y
CONFIG_DM_MMC=y
CONFIG_MMC_SP_EMMC=y
CONFIG_MMC_SP_SD=n
CONFIG_SYS_ARCH_TIMER=y
# CONFIG_SP_TIMER is not set
CONFIG_DEBUG_UART_BASE=0x0
CONFIG_DEBUG_UART_CLOCK=90000
CONFIG_DEBUG_UART_SHIFT=2
CONFIG_EYS3D_SERIAL=y
#
# Soc
#
CONFIG_OTP_EYS3D=y
#
# Pin controllers & GPIO
#
CONFIG_PINCTRL_EYS3D_eCV5546=y
CONFIG_CMD_GPIO=y
#
# Net
#
CONFIG_NET=n
CONFIG_NET_RANDOM_ETHADDR=n
CONFIG_SYS_RX_ETH_BUFFER=16
#
# Network commands
#
CONFIG_CMD_NET=n
CONFIG_CMD_TFTPPUT=n
CONFIG_CMD_DHCP=n
CONFIG_CMD_PING=n

CONFIG_CMD_UNZIP=y
# CONFIG_CMD_TPS_MD is not set
# CONFIG_CMD_TPS_UPD is not set
# CONFIG_TPS_UPD_MMC is not set
# CONFIG_TPS_UPD_NAND is not set
# CONFIG_TPS_UPD_TFTP is not set
# CONFIG_TPS_UPD_USB is not set
# CONFIG_TFABOOT is not set
# CONFIG_SYS_ZMEM_SKIP_RELOC is not set

CONFIG_CMD_DM=y
CONFIG_BOARD_LATE_INIT=y
#
# Display
#
CONFIG_VIDEO=n
CONFIG_VIDEO_eCV5546=n
CONFIG_DM_VIDEO_eCV5546_LOGO=n
CONFIG_VIDEO_BMP_RLE8=n
CONFIG_VIDEO_BMP_GZIP=n
CONFIG_BMP_16BPP=n
CONFIG_BMP_24BPP=n
CONFIG_BMP_32BPP=n
#
# Keyboard
#
CONFIG_USE_PREBOOT=n
CONFIG_DM_KEYBOARD=n
CONFIG_USB_KEYBOARD=n
#
# USB
#
CONFIG_DM_USB=y
CONFIG_USB=y
CONFIG_DM_USB_GADGET=y
CONFIG_USB_EHCI_HCD=y
CONFIG_USB_EHCI_EYS3D=y
CONFIG_USB_OHCI_HCD=y
CONFIG_USB_OHCI_EYS3D=y
CONFIG_USB_XHCI_HCD=y
CONFIG_USB_XHCI_SPDWC3=y
CONFIG_USB_STORAGE=y
CONFIG_USB_GADGET=y
CONFIG_USB_GADGET_EYS3D_UDC=y
CONFIG_PHY=y
#
# SPI
#
CONFIG_SPI=y
CONFIG_DM_SPI=y
CONFIG_DESIGNWARE_SPI=y
CONFIG_CMD_SPI=y
CONFIG_DEFAULT_SPI_BUS=0
CONFIG_DEFAULT_SPI_MODE=0
#
# I2C
#
CONFIG_DM_I2C=y
CONFIG_SYS_I2C_DW=y
CONFIG_CMD_I2C=y
#
# Android support commands
#
CONFIG_CMD_BOOTP=n
CONFIG_BOOTP_BOOTPATH=n
CONFIG_BOOTP_DNS=n
CONFIG_BOOTP_DNS2=n
CONFIG_BOOTP_GATEWAY=n
CONFIG_BOOTP_HOSTNAME=n
CONFIG_BOOTP_PREFER_SERVERIP=n
CONFIG_BOOTP_SUBNETMASK=n
CONFIG_BOOTP_NTPSERVER=n
# CONFIG_CMD_PCAP is not set
CONFIG_BOOTP_PXE=y
CONFIG_BOOTP_PXE_CLIENTARCH=0x16
CONFIG_BOOTP_VCI_STRING="U-Boot.armv8"
CONFIG_CMD_TFTPBOOT=n
CONFIG_CMD_TFTPSRV=n
CONFIG_NET_TFTP_VARS=n
# CONFIG_CMD_RARP is not set
CONFIG_CMD_NFS=n
CONFIG_CMD_WGET=n
CONFIG_CMD_MII=n
CONFIG_CMD_MDIO=n
# CONFIG_CMD_CDP is not set
# CONFIG_CMD_SNTP is not set
# CONFIG_CMD_DNS is not set
# CONFIG_CMD_LINK_LOCAL is not set
# CONFIG_CMD_ETHSW is not set
CONFIG_CMD_PXE=y
CONFIG_CMD_WOL=n
#
# Environment
#
CONFIG_PROT_UDP=n
CONFIG_BOOTP_SEND_HOSTNAME=n
# CONFIG_NETCONSOLE is not set
# CONFIG_IP_DEFRAG is not set
CONFIG_TFTP_BLOCKSIZE=1468
CONFIG_TFTP_WINDOWSIZE=1
CONFIG_SERVERIP_FROM_PROXYDHCP=n
CONFIG_SERVERIP_FROM_PROXYDHCP_DELAY_MS=100
#
# Ethernet & PHY
#
CONFIG_PHY_ADDR_ENABLE=n
CONFIG_PHY_ADDR=1
CONFIG_PHY_REALTEK=n
CONFIG_RTL8211F_PHY_FORCE_EEE_RXC_ON=n
CONFIG_DM_ETH=n
CONFIG_DM_MDIO=n
# CONFIG_DM_MDIO_MUX is not set
CONFIG_DM_ETH_PHY=n
CONFIG_PHY_GIGE=n
CONFIG_ETH_DESIGNWARE=n
CONFIG_RGMII=n
CONFIG_MII=n
#
# Fastboot
#
CONFIG_FASTBOOT=y
CONFIG_USB_FUNCTION_FASTBOOT=y
CONFIG_FASTBOOT_BUF_ADDR=0xc00800
CONFIG_FASTBOOT_FLASH=y
CONFIG_FASTBOOT_FLASH_MMC_DEV=0
CONFIG_FASTBOOT_MMC_BOOT_SUPPORT=y
CONFIG_FASTBOOT_MMC_USER_SUPPORT=y
```

## configs/ecv5546_pnand_ev_defconfig
```kconfig
CONFIG_ARM=y
CONFIG_ARCH_PENTAGRAM=y
CONFIG_TARGET_PENTAGRAM_eCV5546=y
CONFIG_SYS_ENV_eCV5546_EVB=y
CONFIG_TEXT_BASE=0x500000
CONFIG_SYS_MALLOC_F_LEN=0x40000
CONFIG_SYS_LOAD_ADDR=0x2000000
CONFIG_SYS_MALLOC_LEN=0x600000
CONFIG_SYS_BOOTM_LEN=0x4000000
# CONFIG_USE_ARCH_MEMCPY is not set
# CONFIG_USE_ARCH_MEMSET is not set
# CONFIG_DEBUG_UART is not set
CONFIG_PHYS_64BIT=y
CONFIG_BOOTDELAY=0
CONFIG_REGEX=y
CONFIG_CMD_BOOTZ=y
CONFIG_CMD_MD5SUM=y
CONFIG_MD5SUM_VERIFY=y
CONFIG_CMD_MEMINFO=y
CONFIG_CMD_MMC=y
CONFIG_CMD_PART=y
CONFIG_CMD_USB=y
CONFIG_CMD_FAT=y
CONFIG_CMD_MTDPARTS=y
CONFIG_MTDIDS_DEFAULT="nand0=sp_paranand.0"
CONFIG_MTDPARTS_DEFAULT="sp_paranand.0:128k(nand_header),384k(xboot1),1536k(uboot1),4096k(uboot2),2m(fip),512k(env),512k(env_redund),256k(dtb),25m(kernel),-(rootfs)"

CONFIG_OF_SEPARATE=y

CONFIG_CLK_CCF=y
CONFIG_CLK_COMPOSITE_CCF=y

CONFIG_MMC_SP_SD=y
CONFIG_DM_MMC=y

CONFIG_SYS_ARCH_TIMER=y
# CONFIG_SP_TIMER is not set

CONFIG_MTD=y
CONFIG_DM_MTD=y
CONFIG_MTD_RAW_NAND=y
CONFIG_SP_PARANAND=y
CONFIG_ENV_IS_IN_NAND=y
CONFIG_ENV_OFFSET=0x800000
CONFIG_ENV_SIZE=0x20000
CONFIG_SYS_REDUNDAND_ENVIRONMENT=y
CONFIG_ENV_OFFSET_REDUND=0x880000

CONFIG_DEBUG_UART_BASE=0x0
CONFIG_DEBUG_UART_CLOCK=90000
CONFIG_DEBUG_UART_SHIFT=2
CONFIG_EYS3D_SERIAL=y
#
# Soc
#
CONFIG_OTP_EYS3D=y
#
# Pin controllers & GPIO
#
CONFIG_PINCTRL_EYS3D_eCV5546=y
CONFIG_CMD_GPIO=y
#
# Net
#
CONFIG_NET=n
CONFIG_NET_RANDOM_ETHADDR=y
#
# Network commands
#
CONFIG_CMD_NET=y
CONFIG_CMD_TFTPPUT=y
CONFIG_CMD_DHCP=y
CONFIG_CMD_PING=y
#
# NAND & UBIFS commands
#
CONFIG_CMD_UBI=y
CONFIG_CMD_UBIFS=y
CONFIG_CMD_NAND=y

CONFIG_CMD_UNZIP=y
# CONFIG_CMD_TPS_MD is not set
# CONFIG_CMD_TPS_UPD is not set
# CONFIG_TPS_UPD_MMC is not set
# CONFIG_TPS_UPD_NAND is not set
# CONFIG_TPS_UPD_TFTP is not set
# CONFIG_TPS_UPD_USB is not set
# CONFIG_TFABOOT is not set
# CONFIG_SYS_ZMEM_SKIP_RELOC is not set

CONFIG_CMD_DM=n
CONFIG_BOARD_LATE_INIT=n
#
# Display
#
CONFIG_VIDEO=n
CONFIG_VIDEO_eCV5546=n
CONFIG_DM_VIDEO_eCV5546_LOGO=n
CONFIG_VIDEO_BMP_RLE8=n
CONFIG_VIDEO_BMP_GZIP=n
CONFIG_BMP_16BPP=n
CONFIG_BMP_24BPP=n
CONFIG_BMP_32BPP=n
#
# Keyboard
#
CONFIG_USE_PREBOOT=n
CONFIG_DM_KEYBOARD=n
CONFIG_USB_KEYBOARD=n
#
# USB
#
CONFIG_DM_USB=y
CONFIG_USB=y
CONFIG_USB_EHCI_HCD=y
CONFIG_USB_EHCI_EYS3D=y
CONFIG_USB_OHCI_HCD=n
CONFIG_USB_OHCI_EYS3D=n
CONFIG_USB_XHCI_HCD=y
CONFIG_USB_XHCI_SPDWC3=y
CONFIG_USB_STORAGE=y
CONFIG_PHY=y
#
# SPI
#
CONFIG_SPI=y
CONFIG_DM_SPI=y
CONFIG_DESIGNWARE_SPI=y
CONFIG_CMD_SPI=y
CONFIG_DEFAULT_SPI_BUS=0
CONFIG_DEFAULT_SPI_MODE=0
#
# I2C
#
CONFIG_DM_I2C=y
CONFIG_SYS_I2C_DW=y
CONFIG_CMD_I2C=y
```

## configs/ecv5546_romter_zebu_defconfig
```kconfig
CONFIG_ARM=y
CONFIG_ARCH_PENTAGRAM=y
CONFIG_TARGET_PENTAGRAM_eCV5546=y
CONFIG_TEXT_BASE=0x500000
CONFIG_SYS_MALLOC_F_LEN=0x40000
CONFIG_SYS_LOAD_ADDR=0x2000000
CONFIG_SYS_MALLOC_LEN=0x600000
CONFIG_SYS_BOOTM_LEN=0x4000000
# CONFIG_USE_ARCH_MEMCPY is not set
# CONFIG_USE_ARCH_MEMSET is not set
# CONFIG_DEBUG_UART is not set
CONFIG_PHYS_64BIT=y
CONFIG_BOOTDELAY=0
CONFIG_CMD_BOOTZ=y
CONFIG_CMD_MD5SUM=y
CONFIG_MD5SUM_VERIFY=y
CONFIG_CMD_MEMINFO=y
CONFIG_CMD_PART=y
CONFIG_CMD_USB=n

CONFIG_CMD_EXT2=y
CONFIG_CMD_FAT=y

CONFIG_OF_SEPARATE=y
CONFIG_CLK_CCF=y
CONFIG_CLK_COMPOSITE_CCF=y

CONFIG_SYS_ARCH_TIMER=y
# CONFIG_SP_TIMER is not set
# CONFIG_MMC is not set
CONFIG_DM_MMC=n
CONFIG_DEBUG_UART_BASE=0x0
CONFIG_DEBUG_UART_CLOCK=90000
CONFIG_DEBUG_UART_SHIFT=2
CONFIG_EYS3D_SERIAL=y
CONFIG_REGEX=y
#
# Soc
#
CONFIG_OTP_EYS3D=y
#
# Pin controllers & GPIO
#
CONFIG_PINCTRL_EYS3D_eCV5546=y
CONFIG_CMD_GPIO=y

CONFIG_SYS_ENV_ZEBU=y
CONFIG_CMD_UNZIP=y
# CONFIG_CMD_TPS_MD is not set
# CONFIG_CMD_TPS_UPD is not set
# CONFIG_TPS_UPD_MMC is not set
# CONFIG_TPS_UPD_NAND is not set
# CONFIG_TPS_UPD_TFTP is not set
# CONFIG_TPS_UPD_USB is not set
# CONFIG_TFABOOT is not set
CONFIG_SYS_ZMEM_SKIP_RELOC=y
CONFIG_SP_ZMEM_RELOC_ADDR=0xfefffc0

CONFIG_CMD_DM=n
CONFIG_BOARD_LATE_INIT=n
#
# Display
#
CONFIG_VIDEO=n
CONFIG_VIDEO_eCV5546=n
CONFIG_DM_VIDEO_eCV5546_LOGO=n
CONFIG_VIDEO_BMP_RLE8=n
CONFIG_VIDEO_BMP_GZIP=n
CONFIG_BMP_16BPP=n
CONFIG_BMP_24BPP=n
CONFIG_BMP_32BPP=n
#
# Keyboard
#
CONFIG_USE_PREBOOT=n
CONFIG_DM_KEYBOARD=n
CONFIG_USB_KEYBOARD=n
#
# USB
#
CONFIG_USB=n
CONFIG_DM_USB=n
CONFIG_USB_EHCI_HCD=n
CONFIG_USB_EHCI_EYS3D=n
CONFIG_USB_OHCI_HCD=n
CONFIG_USB_OHCI_EYS3D=n
CONFIG_USB_STORAGE=y
#
# SPI and I2C
#
CONFIG_DM_I2C=y
CONFIG_SPI=y
CONFIG_DM_SPI=y
CONFIG_DESIGNWARE_SPI=y
CONFIG_CMD_SPI=y
CONFIG_DEFAULT_SPI_BUS=0
CONFIG_DEFAULT_SPI_MODE=0
CONFIG_SYS_I2C_DW=y
CONFIG_CMD_I2C=y
```

## drivers/pinctrl/eys3d/Kconfig
```kconfig
config PINCTRL_EYS3D_eCV5546
	bool "eYs3D eCV5546 Pinctrl and GPIO driver"
	depends on DM && TARGET_PENTAGRAM_eCV5546
	select PINCTRL
	select PINCONF
	select DM_GPIO
	default y
	help
	  Support pin configuration control on eYs3D's eCV5546 SoC.

	  The driver is controlled by a device tree node which contains both
	  the GPIO definitions and pin control functions.
```

## drivers/soc/eys3d/Kconfig
```kconfig
config OTP_EYS3D
	bool "Enable OTP driver support for eYs3D SoC"
	help
	  This OTP driver supports eYs3D eCV5546 SoC.
	  Say Y if you want to enable OTP function.
```

## drivers/video/eys3d/Kconfig
```kconfig
#
# eYs3D Video configuration
#

source "drivers/video/eys3d/ecv5546/disp/Kconfig"
```

## drivers/video/eys3d/ecv5546/disp/Kconfig
```kconfig
# SPDX-License-Identifier: GPL-2.0+
#
# Copyright (C) 2022 eys3d - All Rights Reserved
#
# Authors: Hammer Hsieh <eys3d@eys3d.com>
#

menuconfig VIDEO_eCV5546
	bool "Enable eCV5546 video support"
	select DM_VIDEO
	select DM_GPIO
	select CMD_BMP
	select CMD_CLS
	# default y
	help
	  eCV5546 supports MIPI DSI video output. This option enables
	  display function.

config eCV5546_LT8912B_BRIDGE
	bool "Enable eCV5546 LT8912B_HDMI bridge"
	depends on VIDEO_eCV5546
	default y
	help
		Enable this will init LT8912B_HDMI bridge via I2C6.

config eCV5546_RASPBERRYPI_DSI_PANEL
	bool "Enable eCV5546 RASPBERRYPI_DSI_PANEL"
	depends on VIDEO_eCV5546
	default n
	help
		Enable this will init RASPBERRYPI_DSI_PANEL via I2C6.

config VIDEO_eCV5546_MAX_XRES
	int "Maximum horizontal resolution (for memory allocation purposes)"
	depends on VIDEO_eCV5546
	default 1920
	help
	  The maximum horizontal resolution to support for the framebuffer.
	  This configuration is used for reserving/allocating memory for the
	  framebuffer during device-model binding/probing.

config VIDEO_eCV5546_MAX_YRES
	int "Maximum vertical resolution (for memory allocation purposes)"
	depends on VIDEO_eCV5546
	default 1080
	help
	  The maximum vertical resolution to support for the framebuffer.
	  This configuration is used for reserving/allocating memory for the
	  framebuffer during device-model binding/probing.

config VIDEO_eCV5546_MAX_BPP
	int "Maximum bits per pixel (for memory allocation purposes)"
	depends on VIDEO_eCV5546
	default 16
	help
	  The maximum bits per pixel to support for the framebuffer.
	  This configuration is used for reserving/allocating memory for the
	  framebuffer during device-model binding/probing.

config VIDEO_eCV5546_ROTATE
	int "Console Text Rotate Angle Setting"
	depends on VIDEO_eCV5546
	default 0
	help
	  Rotate angle 0: 0 degree / 1: 90 degree / 2: 180 degree / 3: 270 degree.

config BMP_8BPP_UPDATE_CMAP
	bool "Enable eCV5546 Update Palette for 8BPP"
	depends on VIDEO_eCV5546
	default y
	help
		Allow 8BPP format update palette.

config DM_VIDEO_eCV5546_LOGO
	bool "Enable eCV5546 video LOGO support"
	depends on VIDEO_eCV5546
	default n
	help
		Logo display support

config DM_VIDEO_eCV5546_LOGO_ALIGN
	bool "Align eCV5546 video LOGO to center"
	depends on VIDEO_eCV5546
	default n
	help
		Logo display support , align to center

config VIDEO_BMP_LOGO_MANUAL
	bool "LOGO display by manual"
	depends on VIDEO_eCV5546
	default n
	help
		Logo display by manual
```
